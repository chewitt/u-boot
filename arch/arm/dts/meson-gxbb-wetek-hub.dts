// SPDX-License-Identifier: (GPL-2.0+ OR MIT)
/*
 * Copyright (c) 2016 BayLibre, Inc.
 * Author: Neil Armstrong <narmstrong@baylibre.com>
 */

/dts-v1/;

#include "meson-gxbb-wetek.dtsi"

/ {
	compatible = "wetek,hub", "amlogic,meson-gxbb";
	model = "WeTek Hub";

	memory@0 {
		device_type = "memory";
		reg = <0x0 0x0 0x0 0x40000000>;
	};
};

&ir {
	linux,rc-map-name = "rc-wetek-hub";
};
