// SPDX-License-Identifier: (GPL-2.0+ OR MIT)
/*
 * Copyright (c) 2023 Christian Hewitt <christianshewitt@gmail.com>
 */

/dts-v1/;

#include "meson-g12b-a311d.dtsi"
#include "meson-g12b-bananapi.dtsi"

/ {
	compatible = "bananapi,bpi-m2s", "amlogic,a311d", "amlogic,g12b";
	model = "BananaPi M2S";
};
