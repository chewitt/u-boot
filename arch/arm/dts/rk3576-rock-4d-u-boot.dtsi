// SPDX-License-Identifier: (GPL-2.0+ OR MIT)

#include "rk3576-u-boot.dtsi"

&rgmii_phy0 {
	/delete-property/ reset-gpio;
	reset-gpios = <&gpio2 RK_PB5 GPIO_ACTIVE_LOW>;
};

&sfc0 {
	flash@0 {
		bootph-pre-ram;
		bootph-some-ram;
	};
};
